## examples/display/dsi/sdkconfig.defaults
```kconfig
# Enable PSRAM for the selected DSI panel and LVGL draw buffers.
# The default panel remains the board configuration; adapters are selected in menuconfig.
CONFIG_IDF_TARGET="esp32p4"
CONFIG_ESPTOOLPY_FLASHSIZE_16MB=y
CONFIG_SPIRAM=y
CONFIG_SPIRAM_SPEED_200M=y
CONFIG_SPIRAM_XIP_FROM_PSRAM=y
CONFIG_CACHE_L2_CACHE_256KB=y
CONFIG_CACHE_L2_CACHE_LINE_128B=y
CONFIG_ESP_MAIN_TASK_STACK_SIZE=10240
CONFIG_FREERTOS_HZ=1000
CONFIG_LV_USE_CLIB_MALLOC=y
CONFIG_LV_USE_CLIB_STRING=y
CONFIG_LV_DEF_REFR_PERIOD=15
CONFIG_LV_DRAW_BUF_ALIGN=128
CONFIG_LV_DRAW_LAYER_SIMPLE_BUF_SIZE=102400
CONFIG_IDF_EXPERIMENTAL_FEATURES=y
CONFIG_PARTITION_TABLE_CUSTOM=y
CONFIG_PARTITION_TABLE_CUSTOM_FILENAME="partitions.csv"
CONFIG_LV_COLOR_DEPTH_24=y
CONFIG_LV_USE_OBSERVER=y
CONFIG_LV_USE_SYSMON=y
CONFIG_LV_USE_PERF_MONITOR=y
CONFIG_LV_FONT_MONTSERRAT_48=y
CONFIG_LV_FONT_MONTSERRAT_24=y
CONFIG_LV_FONT_MONTSERRAT_16=y
CONFIG_LV_FONT_MONTSERRAT_14=y
CONFIG_LV_FONT_MONTSERRAT_12=y
CONFIG_LV_BUILD_DEMOS=y
CONFIG_EXAMPLE_DSI_DEMO_WIDGETS=y

CONFIG_WT_BSP_ENABLE_RGB=n
CONFIG_WT_BSP_ENABLE_BUTTON=n
CONFIG_WT_BSP_ENABLE_SDMMC=n
CONFIG_WT_BSP_ENABLE_DSI=y
CONFIG_WT_BSP_ENABLE_CSI=n
CONFIG_WT_BSP_ENABLE_TOUCH=y
CONFIG_WT_BSP_ENABLE_USB_DEVICE_CDC=n
```

## examples/usb/device_cdc/sdkconfig.defaults
```kconfig
CONFIG_ESPTOOLPY_FLASHSIZE_16MB=y
CONFIG_IDF_EXPERIMENTAL_FEATURES=y
CONFIG_WT_BSP_ENABLE_RGB=n
CONFIG_WT_BSP_ENABLE_BUTTON=n
CONFIG_WT_BSP_ENABLE_SDMMC=n
CONFIG_WT_BSP_ENABLE_DSI=n
CONFIG_WT_BSP_ENABLE_CSI=n
CONFIG_WT_BSP_ENABLE_TOUCH=n
CONFIG_WT_BSP_ENABLE_USB_DEVICE_UVC=n
CONFIG_WT_BSP_ENABLE_USB_DEVICE_CDC=y
CONFIG_TINYUSB_CDC_ENABLED=y
CONFIG_TINYUSB_CDC_COUNT=1
CONFIG_TINYUSB_DESC_MANUFACTURER_STRING="Wireless-Tag"
CONFIG_TINYUSB_DESC_PRODUCT_STRING="Wireless-Tag CDC"
```

## examples/wt_factory/wt9932s31-tiny/main/Kconfig.projbuild
```kconfig
menu "S31 factory"
    config WT_FACTORY_ENABLE_SD_RECORDING
        bool "Enable SD card recording"
        default n
        help
            Save camera frames as MJPEG AVI files when J1 is not enumerated.
            SW2 pauses/resumes recording. Continuous recording writes large
            amounts of data and consumes SD card capacity and write endurance.

            When disabled, keep camera capture and SD health checks running
            without creating recording directories or writing video files.
            SW2 only logs button events. UVC, CDC and reading existing recordings
            remain available in USB mode.

    config WT_FACTORY_SEGMENT_SECONDS
        int "Maximum recording segment duration (seconds)"
        depends on WT_FACTORY_ENABLE_SD_RECORDING
        range 1 300
        default 60
        help
            Finalize the AVI and start a new file at this duration or 64 MiB.
            Pausing or switching to USB mode also finalizes the current file.
            A power interruption may leave the current .avi.part incomplete.
endmenu
```

## examples/wt_factory/wt9932s31-tiny/sdkconfig.defaults
```kconfig
CONFIG_IDF_TARGET="esp32s31"
CONFIG_IDF_EXPERIMENTAL_FEATURES=y
CONFIG_ESPTOOLPY_FLASHSIZE_16MB=y
CONFIG_SPIRAM=y
CONFIG_SPIRAM_SPEED_250M=y
CONFIG_ESP_MAIN_TASK_STACK_SIZE=8192

CONFIG_WT_BSP_ENABLE_RGB=y
CONFIG_WT_BSP_ENABLE_BUTTON=y
CONFIG_WT_BSP_ENABLE_SDMMC=y
CONFIG_WT_BSP_ENABLE_CAMERA=y
CONFIG_WT_BSP_ENABLE_USB_DEVICE_UVC=y
CONFIG_WT_BSP_USB_DEVICE_COMPOSITE=y
CONFIG_WT_BSP_ENABLE_USB_DEVICE_CDC=y

# Select the fitted sensor in menuconfig. Board Kconfig derives its USB profile.
CONFIG_WT_BSP_S31_CAMERA_SENSOR_GC2145=y
CONFIG_CAMERA_GC2145_DVP_DEFAULT_FMT_RGB565_BE_1600X1200_13FPS=y
CONFIG_CAMERA_XCLK_USE_LEDC=y
# CONFIG_CAMERA_GC2145_AUTO_DETECT_DVP_INTERFACE_SENSOR is not set
# CONFIG_CAMERA_OV3660_AUTO_DETECT_DVP_INTERFACE_SENSOR is not set
CONFIG_ESP_VIDEO_ENABLE_DVP_VIDEO_DEVICE=y
CONFIG_ESP_VIDEO_ENABLE_HW_JPEG_ENC_VIDEO_DEVICE=y
CONFIG_WT_BSP_S31_JPEG_ENCODE_TIMEOUT_MS=200

# Distinct PID avoids caching the earlier UVC-only interface layout on a host.
CONFIG_TUSB_VID=0x303A
CONFIG_TUSB_PID=0x8001
CONFIG_TUSB_MANUFACTURER="Wireless-Tag"
CONFIG_TUSB_PRODUCT="Wireless-Tag Factory"
CONFIG_TUSB_SERIAL_NUM="ESP32S31-FACTORY"
CONFIG_TINYUSB_RHPORT_HS=y
CONFIG_FORMAT_MJPEG_CAM1=y
CONFIG_UVC_MODE_BULK_CAM1=y
# CONFIG_UVC_CAM1_MULTI_FRAMESIZE is not set
# CONFIG_UVC_SUPPORT_TWO_CAM is not set

CONFIG_FATFS_LFN_HEAP=y
CONFIG_FATFS_VFS_FSTAT_BLKSIZE=4096
# CONFIG_WT_FACTORY_ENABLE_SD_RECORDING is not set
```
