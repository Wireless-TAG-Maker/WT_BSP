## components/wt_bsp/Kconfig.projbuild
```kconfig
menu "WT BSP"

    rsource "boards/Kconfig.projbuild"
    rsource "features/Kconfig.projbuild"

endmenu
```

## components/wt_bsp/features/board/Kconfig.projbuild
```kconfig
config WT_BSP_BOARD_HAS_BOARD
    bool

config WT_BSP_ENABLE_BOARD
    bool
    depends on WT_BSP_BOARD_HAS_BOARD
    default y
```

## components/wt_bsp/features/sdmmc/Kconfig.projbuild
```kconfig
config WT_BSP_BOARD_HAS_SDMMC
    bool

config WT_BSP_ENABLE_SDMMC
    bool "Enable SDMMC storage BSP"
    depends on WT_BSP_BOARD_HAS_SDMMC
    default y
```

## examples/camera/csi/sdkconfig.defaults
```kconfig
# WT9932P4-TINY CSI to DSI example
CONFIG_IDF_TARGET="esp32p4"
CONFIG_ESPTOOLPY_FLASHSIZE_16MB=y
CONFIG_SPIRAM=y
CONFIG_SPIRAM_SPEED_200M=y
CONFIG_SPIRAM_XIP_FROM_PSRAM=y
CONFIG_CACHE_L2_CACHE_256KB=y
CONFIG_CACHE_L2_CACHE_LINE_128B=y
CONFIG_ESP_MAIN_TASK_STACK_SIZE=10240
CONFIG_FREERTOS_HZ=1000

# Camera Sensor
CONFIG_CAMERA_SC2336=y
CONFIG_CAMERA_SC2336_AUTO_DETECT=y
CONFIG_CAMERA_SC2336_AUTO_DETECT_MIPI_INTERFACE_SENSOR=y
CONFIG_CAMERA_SC2336_MIPI_RAW8_1024x600_30FPS=y
CONFIG_CAMERA_XCLK_USE_ESP_CLOCK_ROUTER=y

# Video / ISP
CONFIG_ESP_VIDEO_ENABLE_ISP_PIPELINE_CONTROLLER=y

# Experimental features for P4
CONFIG_IDF_EXPERIMENTAL_FEATURES=y

CONFIG_WT_BSP_ENABLE_RGB=n
CONFIG_WT_BSP_ENABLE_BUTTON=n
CONFIG_WT_BSP_ENABLE_SDMMC=n
CONFIG_WT_BSP_ENABLE_DSI=y
CONFIG_WT_BSP_ENABLE_CSI=y
CONFIG_WT_BSP_ENABLE_TOUCH=n
```

## examples/get-started/blink/sdkconfig.defaults.esp32p4
```kconfig
CONFIG_ESP32P4_SELECTS_REV_LESS_V3=y

CONFIG_ESPTOOLPY_FLASHMODE_QIO=y
CONFIG_ESPTOOLPY_FLASHSIZE_16MB=y
CONFIG_ESPTOOLPY_FLASHSIZE="16MB"
CONFIG_COMPILER_DISABLE_DEFAULT_ERRORS=y
CONFIG_ESP_MAIN_TASK_STACK_SIZE=16384

CONFIG_SPIRAM=y
CONFIG_SPIRAM_MODE_HEX=y
CONFIG_SPIRAM_SPEED_200M=y

CONFIG_WT_BSP_ENABLE_RGB=y
CONFIG_WT_BSP_ENABLE_BUTTON=y
CONFIG_WT_BSP_ENABLE_SDMMC=n
CONFIG_WT_BSP_ENABLE_DSI=n
CONFIG_WT_BSP_ENABLE_CSI=n
CONFIG_WT_BSP_ENABLE_TOUCH=n
```

## examples/get-started/button/sdkconfig.defaults.esp32p4
```kconfig
CONFIG_ESPTOOLPY_FLASHMODE_QIO=y
CONFIG_ESPTOOLPY_FLASHSIZE_16MB=y
CONFIG_ESPTOOLPY_FLASHSIZE="16MB"
CONFIG_COMPILER_DISABLE_DEFAULT_ERRORS=y
CONFIG_ESP_MAIN_TASK_STACK_SIZE=16384

CONFIG_SPIRAM=y
CONFIG_SPIRAM_MODE_HEX=y
CONFIG_SPIRAM_SPEED_200M=y
```

## examples/lcd/sdkconfig.defaults.esp32p4
```kconfig
# SPIRAM configuration for ESP32-P4
CONFIG_SPIRAM=y
CONFIG_SPIRAM_MODE_HEX=y
CONFIG_SPIRAM_SPEED_200M=y
CONFIG_ESP32P4_SELECTS_REV_LESS_V3=y

# CPU frequency
CONFIG_ESP_DEFAULT_CPU_FREQ_MHZ_400=y
```

## examples/storage/sdmmc/sdkconfig.defaults
```kconfig
CONFIG_FATFS_VFS_FSTAT_BLKSIZE=4096

CONFIG_WT_BSP_ENABLE_RGB=n
CONFIG_WT_BSP_ENABLE_BUTTON=n
CONFIG_WT_BSP_ENABLE_SDMMC=y
CONFIG_WT_BSP_ENABLE_DSI=n
CONFIG_WT_BSP_ENABLE_CSI=n
CONFIG_WT_BSP_ENABLE_TOUCH=n
```

## examples/wifi/esp-hosted/wt9932p4c61-tiny/main/Kconfig.projbuild
```kconfig
# Wi-Fi 配置
menu "Example Wi-Fi Configuration"

    config ESP_WIFI_SSID
        string "Wi-Fi SSID"
        help
            Wi-Fi网络的SSID名称

    config ESP_WIFI_PASSWORD
        string "Wi-Fi Password"
        help
            Wi-Fi网络的密码（至少8个字符）

    config ESP_MAXIMUM_RETRY
        int "Maximum retry attempts"
        range 1 20
        default 5
        help
            连接失败时的最大重试次数

endmenu
```

## examples/wifi/esp-hosted/wt9932p4c61-tiny/sdkconfig.defaults
```kconfig
# ESP32-P4 ESP-Hosted Master 配置

# 分区表配置 - 使用自定义 2MB app 分区以容纳 esp-wifi-connect 组件
CONFIG_PARTITION_TABLE_CUSTOM=y
CONFIG_PARTITION_TABLE_CUSTOM_FILENAME="partitions.csv"
CONFIG_PARTITION_TABLE_OFFSET=0x8000
CONFIG_ESPTOOLPY_FLASHSIZE_16MB=y

# 系统事件任务栈大小 - esp-wifi-connect 需要更大的栈
CONFIG_ESP_SYSTEM_EVENT_TASK_STACK_SIZE=8192

# 注意：SDIO GPIO 配置需要在 menuconfig 中设置
# Component config -> ESP-Hosted config -> SDIO Configuration
# 请手动设置:
#   CLK GPIO = 18
#   CMD GPIO = 19
#   D0 GPIO = 14
#   D1 GPIO = 15
#   D2 GPIO = 16
#   D3 GPIO = 17
#   Slave Reset GPIO = 13

# Wi-Fi 配置
CONFIG_ESP_MAXIMUM_RETRY=5
CONFIG_ESP_WIFI_SSID="CMW-AP2025"
CONFIG_ESP_WIFI_PASSWORD="12345678"

# LWIP 配置优化
CONFIG_LWIP_TCP_SND_BUF_DEFAULT=65534
CONFIG_LWIP_TCP_WND_DEFAULT=65534
CONFIG_LWIP_TCP_RECVMBOX_SIZE=64
CONFIG_LWIP_UDP_RECVMBOX_SIZE=64
CONFIG_LWIP_TCPIP_RECVMBOX_SIZE=64
CONFIG_LWIP_TCP_SACK_OUT=y

# Wi-Fi 缓冲区配置
CONFIG_WIFI_RMT_STATIC_RX_BUFFER_NUM=16
CONFIG_WIFI_RMT_DYNAMIC_RX_BUFFER_NUM=64
CONFIG_WIFI_RMT_DYNAMIC_TX_BUFFER_NUM=64
CONFIG_WIFI_RMT_AMPDU_TX_ENABLED=y
CONFIG_WIFI_RMT_TX_BA_WIN=32
CONFIG_WIFI_RMT_AMPDU_RX_ENABLED=y
CONFIG_WIFI_RMT_RX_BA_WIN=32

# ESP-Hosted SDIO GPIO 配置
CONFIG_ESP_HOSTED_PRIV_SDIO_PIN_CMD_SLOT_1=19
CONFIG_ESP_HOSTED_PRIV_SDIO_PIN_CLK_SLOT_1=18
CONFIG_ESP_HOSTED_PRIV_SDIO_PIN_D0_SLOT_1=14
CONFIG_ESP_HOSTED_PRIV_SDIO_PIN_D1_4BIT_BUS_SLOT_1=15
CONFIG_ESP_HOSTED_PRIV_SDIO_PIN_D2_4BIT_BUS_SLOT_1=16
CONFIG_ESP_HOSTED_PRIV_SDIO_PIN_D3_4BIT_BUS_SLOT_1=17
CONFIG_ESP_HOSTED_SDIO_GPIO_RESET_SLAVE=13
CONFIG_SLAVE_IDF_TARGET_ESP32C61=y

# WT-BSP 配置
CONFIG_WT_BSP=y
CONFIG_WT_BSP_BOARD_WT9932P4C61_TINY=y

CONFIG_BOOTLOADER_LOG_LEVEL_WARN=y
CONFIG_BOOTLOADER_LOG_LEVEL=2
```

## examples/wt_factory/esp32p4/sdkconfig.defaults.esp32p4
```kconfig
CONFIG_COMPILER_OPTIMIZATION_SIZE=y

CONFIG_SPIRAM=y
CONFIG_SPIRAM_MODE_HEX=y
CONFIG_SPIRAM_SPEED_200M=y

CONFIG_LV_USE_DEMO_WIDGETS=y
CONFIG_LV_USE_DEMO_BENCHMARK=y
CONFIG_LV_USE_DEMO_MUSIC=y
CONFIG_LV_DEMO_MUSIC_AUTO_PLAY=y

CONFIG_ESPTOOLPY_FLASHMODE_QIO=y
CONFIG_ESPTOOLPY_FLASHSIZE_16MB=y
CONFIG_ESPTOOLPY_FLASHSIZE="16MB"
CONFIG_LV_MEM_SIZE_KILOBYTES=256
CONFIG_COMPILER_DISABLE_DEFAULT_ERRORS=y
CONFIG_ESP_MAIN_TASK_STACK_SIZE=16384

CONFIG_EXAMPLE_LCD_USE_ST7102=y
CONFIG_LV_FONT_MONTSERRAT_12=y
CONFIG_LV_FONT_MONTSERRAT_14=y
CONFIG_LV_FONT_MONTSERRAT_16=y
CONFIG_LV_FONT_MONTSERRAT_24=y
CONFIG_LV_FONT_MONTSERRAT_26=y
CONFIG_LV_FONT_MONTSERRAT_30=y
CONFIG_LV_FONT_MONTSERRAT_32=y
CONFIG_LV_FONT_MONTSERRAT_38=y

CONFIG_ESP32P4_SELECTS_REV_LESS_V3=y

CONFIG_PARTITION_TABLE_CUSTOM=y
CONFIG_PARTITION_TABLE_CUSTOM_FILENAME="partitions_16MB.csv"

CONFIG_CAMERA_SC2336=y
CONFIG_CAMERA_SC2336_AUTO_DETECT=y
CONFIG_CAMERA_SC2336_AUTO_DETECT_MIPI_INTERFACE_SENSOR=y
CONFIG_CAMERA_SC2336_MIPI_RAW8_1024x600_30FPS=y
CONFIG_CAMERA_SC2336_MIPI_IF_FORMAT_INDEX_DAFAULT=11
CONFIG_CAMERA_SC2336_DVP_RAW10_1280x720_30FPS=y
CONFIG_CAMERA_SC2336_DVP_IF_FORMAT_INDEX_DAFAULT=12
CONFIG_CAMERA_SC2336_ABSOLUTE_GAIN_LIMIT=66016
CONFIG_CAMERA_SC2336_DIG_GAIN_PRIORITY=y
CONFIG_CAMERA_SC2336_DEFAULT_IPA_JSON_CONFIGURATION_FILE=y
CONFIG_CAMERA_XCLK_USE_ESP_CLOCK_ROUTER=y

CONFIG_LV_USE_LOG=y
#CONFIG_LV_LOG_PRINTF=y
```

## examples/wt_factory/wt9932p4c61-tiny/sdkconfig.defaults
```kconfig
CONFIG_IDF_TARGET="esp32p4"
CONFIG_IDF_TARGET_ESP32P4=y

CONFIG_LV_CONF_SKIP=y
CONFIG_LV_COLOR_DEPTH_24=y
CONFIG_LV_USE_OBSERVER=y
CONFIG_LV_MEM_SIZE_KILOBYTES=256
CONFIG_LV_FONT_MONTSERRAT_16=y

# ESP-Hosted and Wi-Fi
CONFIG_ESP_SYSTEM_EVENT_TASK_STACK_SIZE=8192
CONFIG_WIFI_RMT_STATIC_RX_BUFFER_NUM=16
CONFIG_WIFI_RMT_DYNAMIC_RX_BUFFER_NUM=64
CONFIG_WIFI_RMT_DYNAMIC_TX_BUFFER_NUM=64
CONFIG_WIFI_RMT_AMPDU_TX_ENABLED=y
CONFIG_WIFI_RMT_TX_BA_WIN=32
CONFIG_WIFI_RMT_AMPDU_RX_ENABLED=y
CONFIG_WIFI_RMT_RX_BA_WIN=32
CONFIG_ESP_HOSTED_PRIV_SDIO_PIN_CMD_SLOT_1=19
CONFIG_ESP_HOSTED_PRIV_SDIO_PIN_CLK_SLOT_1=18
CONFIG_ESP_HOSTED_PRIV_SDIO_PIN_D0_SLOT_1=14
CONFIG_ESP_HOSTED_PRIV_SDIO_PIN_D1_4BIT_BUS_SLOT_1=15
CONFIG_ESP_HOSTED_PRIV_SDIO_PIN_D2_4BIT_BUS_SLOT_1=16
CONFIG_ESP_HOSTED_PRIV_SDIO_PIN_D3_4BIT_BUS_SLOT_1=17
CONFIG_ESP_HOSTED_SDIO_GPIO_RESET_SLAVE=13
CONFIG_SLAVE_IDF_TARGET_ESP32C61=y

CONFIG_IDF_EXPERIMENTAL_FEATURES=y
CONFIG_ESP_VIDEO_ENABLE_ISP_PIPELINE_CONTROLLER=y
```

## examples/wt_factory/wt9932p4c61-tiny/sdkconfig.defaults.esp32p4
```kconfig
CONFIG_SPIRAM=y
CONFIG_SPIRAM_SPEED_200M=y

CONFIG_PARTITION_TABLE_CUSTOM=y
CONFIG_PARTITION_TABLE_CUSTOM_FILENAME="partitions_16MB.csv"

CONFIG_ESPTOOLPY_FLASHMODE_QIO=y
CONFIG_ESPTOOLPY_FLASHSIZE_16MB=y
CONFIG_ESPTOOLPY_FLASHSIZE="16MB"
CONFIG_COMPILER_DISABLE_DEFAULT_ERRORS=y
CONFIG_ESP_MAIN_TASK_STACK_SIZE=32768

CONFIG_EXAMPLE_LCD_USE_ST7102=y

CONFIG_CAMERA_SC2336=y
CONFIG_CAMERA_SC2336_AUTO_DETECT=y
CONFIG_CAMERA_SC2336_AUTO_DETECT_MIPI_INTERFACE_SENSOR=y
CONFIG_CAMERA_SC2336_MIPI_RAW8_1024x600_30FPS=y
CONFIG_CAMERA_SC2336_MIPI_IF_FORMAT_INDEX_DAFAULT=11
CONFIG_CAMERA_SC2336_DVP_RAW10_1280x720_30FPS=y
CONFIG_CAMERA_SC2336_DVP_IF_FORMAT_INDEX_DAFAULT=12
CONFIG_CAMERA_SC2336_ABSOLUTE_GAIN_LIMIT=66016
CONFIG_CAMERA_SC2336_DIG_GAIN_PRIORITY=y
CONFIG_CAMERA_SC2336_DEFAULT_IPA_JSON_CONFIGURATION_FILE=y
CONFIG_CAMERA_XCLK_USE_ESP_CLOCK_ROUTER=y
```
