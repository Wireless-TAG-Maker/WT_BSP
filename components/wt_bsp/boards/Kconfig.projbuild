## components/wt_bsp/features/usb_device_uvc/Kconfig.projbuild
```kconfig
config WT_BSP_BOARD_HAS_USB_DEVICE_UVC
    bool

config WT_BSP_ENABLE_USB_DEVICE_UVC
    bool "Enable USB Device UVC"
    depends on WT_BSP_BOARD_HAS_USB_DEVICE_UVC
    default n
    help
        Prepare a USB video device independently of the capture hardware.
        The application supplies frame callbacks and starts USB explicitly.
        No camera, encoder, CSI or RGB feature is selected automatically.
        A second independent USB device driver cannot run at the same time.

config WT_BSP_USB_DEVICE_COMPOSITE_AVAILABLE
    bool
    help
        Selected by an application that provides compatible UVC+CDC USB
        descriptors. A board capability alone does not provide that profile.

config WT_BSP_USB_DEVICE_COMPOSITE
    bool "Share USB UVC and CDC"
    depends on WT_BSP_BOARD_HAS_USB_DEVICE_CDC && WT_BSP_ENABLE_USB_DEVICE_UVC
    depends on WT_BSP_USB_DEVICE_COMPOSITE_AVAILABLE
    default n
    help
        Use one USB device stack for UVC video and CDC serial interfaces.
        The application must supply matching composite descriptors and start
        UVC before using CDC. No capture or encoding pipeline is implied.

# Keep a value in sdkconfig.json even when the capability hides the bool.
config WT_BSP_DEP_USB_DEVICE_UVC
    string
    default "y" if WT_BSP_ENABLE_USB_DEVICE_UVC
    default "n"
```

## examples/camera/usb_device_uvc/sdkconfig.defaults.esp32p4
```kconfig
# ESP32-P4 TINY CSI to USB Device UVC example
CONFIG_IDF_TARGET="esp32p4"
CONFIG_ESPTOOLPY_FLASHSIZE_16MB=y
CONFIG_SPIRAM=y
CONFIG_SPIRAM_SPEED_200M=y
CONFIG_SPIRAM_XIP_FROM_PSRAM=y
CONFIG_CACHE_L2_CACHE_256KB=y
CONFIG_CACHE_L2_CACHE_LINE_128B=y
CONFIG_ESP_MAIN_TASK_STACK_SIZE=10240
CONFIG_FREERTOS_HZ=1000

# Logging
CONFIG_LOG_DYNAMIC_LEVEL_CONTROL=y
CONFIG_LOG_TAG_LEVEL_IMPL_CACHE_AND_LINKED_LIST=y

# Camera sensor
CONFIG_CAMERA_SC2336=y
CONFIG_CAMERA_SC2336_AUTO_DETECT_MIPI_INTERFACE_SENSOR=y
CONFIG_CAMERA_SC2336_MIPI_RAW8_1024X600_30FPS=y
CONFIG_CAMERA_SC2336_MIPI_DEFAULT_FMT_RAW8_1024X600_30FPS=y
CONFIG_CAMERA_XCLK_USE_ESP_CLOCK_ROUTER=y

# Video / ISP / hardware JPEG
CONFIG_ESP_VIDEO_ENABLE_ISP_PIPELINE_CONTROLLER=y
CONFIG_ESP_VIDEO_ENABLE_HW_JPEG_ENC_VIDEO_DEVICE=y

# USB Device UVC
CONFIG_TUSB_MANUFACTURER="Wireless-Tag"
CONFIG_TUSB_PRODUCT="Wireless-Tag CSI Camera"
CONFIG_TINYUSB_RHPORT_HS=y
CONFIG_FORMAT_MJPEG_CAM1=y
CONFIG_UVC_MODE_ISOC_CAM1=y
CONFIG_FRAMESIZE_SVGA=y
CONFIG_UVC_CAM1_FRAMESIZE_WIDTH=1024
CONFIG_UVC_CAM1_FRAMESIZE_HEIGT=600
CONFIG_UVC_CAM1_FRAMERATE=30
# CONFIG_UVC_CAM1_MULTI_FRAMESIZE is not set
# CONFIG_UVC_SUPPORT_TWO_CAM is not set

# BSP feature selection
CONFIG_WT_BSP_ENABLE_USB_DEVICE_UVC=y
CONFIG_WT_BSP_ENABLE_RGB=y
CONFIG_WT_BSP_ENABLE_BUTTON=n
CONFIG_WT_BSP_ENABLE_SDMMC=n
CONFIG_WT_BSP_ENABLE_DSI=n
CONFIG_WT_BSP_ENABLE_CSI=y
CONFIG_WT_BSP_ENABLE_TOUCH=n

# Experimental features for ESP32-P4
CONFIG_IDF_EXPERIMENTAL_FEATURES=y
```

## examples/common_components/wt_camera_uvc/Kconfig.projbuild
```kconfig
menu "Camera UVC application"

    config WT_CAMERA_UVC_P4_CSI_PROFILE
        bool
        default y if IDF_TARGET_ESP32P4 && WT_BSP_ENABLE_CSI && WT_BSP_ENABLE_USB_DEVICE_UVC
        select ESP_VIDEO_ENABLE_HW_JPEG_ENC_VIDEO_DEVICE
        set UVC_CAM1_FRAMERATE=30
        set UVC_CAM1_FRAMESIZE_WIDTH=1024
        set UVC_CAM1_FRAMESIZE_HEIGT=600
        help
            Match the application USB profile to the TINY P4 CSI capture mode.
            This profile is active only when CSI and USB UVC are both enabled.

    config WT_CAMERA_UVC_S31_USB_PROFILE
        bool
        default y if IDF_TARGET_ESP32S31 && WT_BSP_ENABLE_CAMERA && WT_BSP_ENABLE_USB_DEVICE_UVC
        select WT_BSP_USB_DEVICE_COMPOSITE_AVAILABLE
        help
            This application supplies the S31 UVC/CDC descriptor profile.

    config WT_CAMERA_UVC_S31_GC2145_PROFILE
        bool
        default y if IDF_TARGET_ESP32S31 && WT_BSP_ENABLE_CAMERA && WT_BSP_ENABLE_USB_DEVICE_UVC && WT_BSP_S31_CAMERA_SENSOR_GC2145
        set UVC_CAM1_FRAMERATE=8
        set UVC_CAM1_FRAMESIZE_WIDTH=1600
        set UVC_CAM1_FRAMESIZE_HEIGT=1200
        help
            Application profile connecting GC2145 JPEG capture to USB UVC.
            The board camera's own format remains independent of USB settings.

    config WT_CAMERA_UVC_S31_GC2145_720P_PROFILE
        bool
        default y if IDF_TARGET_ESP32S31 && WT_BSP_ENABLE_CAMERA && WT_BSP_ENABLE_USB_DEVICE_UVC && WT_BSP_S31_CAMERA_SENSOR_GC2145_720P
        set UVC_CAM1_FRAMERATE=30
        set UVC_CAM1_FRAMESIZE_WIDTH=1280
        set UVC_CAM1_FRAMESIZE_HEIGT=720
        help
            Application profile connecting GC2145 720p JPEG capture to USB UVC.

    config WT_CAMERA_UVC_S31_OV3660_PROFILE
        bool
        default y if IDF_TARGET_ESP32S31 && WT_BSP_ENABLE_CAMERA && WT_BSP_ENABLE_USB_DEVICE_UVC && WT_BSP_S31_CAMERA_SENSOR_OV3660
        set UVC_CAM1_FRAMERATE=25
        set UVC_CAM1_FRAMESIZE_WIDTH=640
        set UVC_CAM1_FRAMESIZE_HEIGT=480
        help
            Application profile connecting OV3660 JPEG capture to USB UVC.

endmenu
```

## examples/display/dsi/main/Kconfig.projbuild
```kconfig
menu "DSI example"
    depends on WT_BSP_ENABLE_DSI

    choice EXAMPLE_DSI_DEMO
        prompt "LVGL demo"
        default EXAMPLE_DSI_DEMO_WIDGETS

        config EXAMPLE_DSI_DEMO_WIDGETS
            bool "Widgets"
            select LV_BUILD_DEMOS
            select LV_USE_DEMO_WIDGETS

        config EXAMPLE_DSI_DEMO_BENCHMARK
            bool "Benchmark"
            select LV_BUILD_DEMOS
            select LV_USE_DEMO_BENCHMARK
            help
                Run the official LVGL Benchmark. LVGL 9.5 and newer also
                export per-scene results and leave a scrollable result table.
    endchoice

endmenu
```
