## components/wt_bsp/boards/WT9932C2-TINY/Kconfig.projbuild
```kconfig
config WT_BSP_SELECTED_BOARD_WT9932C2_TINY  # ignore: multiple-definition
    bool

choice WT_BSP_BOARD  # ignore: multiple-definition
    default WT_BSP_BOARD_WT9932C2_TINY if WT_BSP_SELECTED_BOARD_WT9932C2_TINY
    default WT_BSP_BOARD_WT9932C2_TINY if !WT_BSP_BOARD_SELECTED_BY_TOOL && IDF_TARGET_ESP32C2

    config WT_BSP_BOARD_WT9932C2_TINY
        bool "WT9932C2-TINY"
        depends on IDF_TARGET_ESP32C2
        select WT_BSP_BOARD_HAS_BOARD
        select WT_BSP_BOARD_HAS_BUTTON
        select WT_BSP_BOARD_HAS_RGB
endchoice
```

## components/wt_bsp/boards/WT9932C3-TINY/Kconfig.projbuild
```kconfig
config WT_BSP_SELECTED_BOARD_WT9932C3_TINY  # ignore: multiple-definition
    bool

choice WT_BSP_BOARD  # ignore: multiple-definition
    default WT_BSP_BOARD_WT9932C3_TINY if WT_BSP_SELECTED_BOARD_WT9932C3_TINY
    default WT_BSP_BOARD_WT9932C3_TINY if !WT_BSP_BOARD_SELECTED_BY_TOOL && IDF_TARGET_ESP32C3

    config WT_BSP_BOARD_WT9932C3_TINY
        bool "WT9932C3-TINY"
        depends on IDF_TARGET_ESP32C3
        select WT_BSP_BOARD_HAS_BOARD
        select WT_BSP_BOARD_HAS_BUTTON
        select WT_BSP_BOARD_HAS_RGB
endchoice
```

## components/wt_bsp/boards/WT9932C5-TINY/Kconfig.projbuild
```kconfig
config WT_BSP_SELECTED_BOARD_WT9932C5_TINY  # ignore: multiple-definition
    bool

choice WT_BSP_BOARD  # ignore: multiple-definition
    default WT_BSP_BOARD_WT9932C5_TINY if WT_BSP_SELECTED_BOARD_WT9932C5_TINY
    default WT_BSP_BOARD_WT9932C5_TINY if !WT_BSP_BOARD_SELECTED_BY_TOOL && IDF_TARGET_ESP32C5

    config WT_BSP_BOARD_WT9932C5_TINY
        bool "WT9932C5-TINY"
        depends on IDF_TARGET_ESP32C5
        select WT_BSP_BOARD_HAS_BOARD
        select WT_BSP_BOARD_HAS_BUTTON
        select WT_BSP_BOARD_HAS_RGB
endchoice
```

## components/wt_bsp/boards/WT9932C61-TINY/Kconfig.projbuild
```kconfig
config WT_BSP_SELECTED_BOARD_WT9932C61_TINY  # ignore: multiple-definition
    bool

choice WT_BSP_BOARD  # ignore: multiple-definition
    default WT_BSP_BOARD_WT9932C61_TINY if WT_BSP_SELECTED_BOARD_WT9932C61_TINY
    default WT_BSP_BOARD_WT9932C61_TINY if !WT_BSP_BOARD_SELECTED_BY_TOOL && IDF_TARGET_ESP32C61

    config WT_BSP_BOARD_WT9932C61_TINY
        bool "WT9932C61-TINY"
        depends on IDF_TARGET_ESP32C61
        select WT_BSP_BOARD_HAS_BOARD
        select WT_BSP_BOARD_HAS_BUTTON
        select WT_BSP_BOARD_HAS_RGB
endchoice
```

## components/wt_bsp/boards/WT9932P4-TINY/Kconfig.projbuild
```kconfig
config WT_BSP_SELECTED_BOARD_WT9932P4_TINY  # ignore: multiple-definition
    bool

choice WT_BSP_BOARD  # ignore: multiple-definition
    default WT_BSP_BOARD_WT9932P4_TINY if WT_BSP_SELECTED_BOARD_WT9932P4_TINY
    default WT_BSP_BOARD_WT9932P4_TINY if !WT_BSP_BOARD_SELECTED_BY_TOOL && IDF_TARGET_ESP32P4

    config WT_BSP_BOARD_WT9932P4_TINY
        bool "WT9932P4-TINY / WT9932P4X-TINY"
        depends on IDF_TARGET_ESP32P4
        select WT_BSP_BOARD_HAS_BOARD
        select WT_BSP_BOARD_HAS_BUTTON
        select WT_BSP_BOARD_HAS_RGB
        select WT_BSP_BOARD_HAS_SDMMC
        select WT_BSP_BOARD_HAS_DSI
        select WT_BSP_BOARD_HAS_DSI_LCD_ADAPTERS if !ESP32P4_SELECTS_REV_LESS_V3
        select WT_BSP_BOARD_HAS_CSI
        select WT_BSP_BOARD_HAS_TOUCH
        select WT_BSP_BOARD_HAS_USB_DEVICE_CDC
        select WT_BSP_BOARD_HAS_USB_DEVICE_UVC
        help
            The P4X variant reuses this board implementation. Configure its
            actual silicon revision and CPU frequency separately, or use the
            matching set-board preset.
endchoice
```

## components/wt_bsp/boards/WT9932P4C61-TINY/Kconfig.projbuild
```kconfig
config WT_BSP_SELECTED_BOARD_WT9932P4C61_TINY  # ignore: multiple-definition
    bool

choice WT_BSP_BOARD  # ignore: multiple-definition
    default WT_BSP_BOARD_WT9932P4C61_TINY if WT_BSP_SELECTED_BOARD_WT9932P4C61_TINY

    config WT_BSP_BOARD_WT9932P4C61_TINY
        bool "WT9932P4C61-TINY"
        depends on IDF_TARGET_ESP32P4
        select WT_BSP_BOARD_HAS_BOARD
        select WT_BSP_BOARD_HAS_BUTTON
        select WT_BSP_BOARD_HAS_RGB
        select WT_BSP_BOARD_HAS_SDMMC
        select WT_BSP_BOARD_HAS_DSI
        select WT_BSP_BOARD_HAS_DSI_LCD_ADAPTERS
        select WT_BSP_BOARD_HAS_CSI
        select WT_BSP_BOARD_HAS_TOUCH
        select WT_BSP_BOARD_HAS_USB_DEVICE_CDC
        select WT_BSP_BOARD_HAS_USB_DEVICE_UVC
endchoice
```

## components/wt_bsp/boards/WT9932S31-TINY/Kconfig.options
```kconfig
if WT_BSP_BOARD_WT9932S31_TINY && WT_BSP_ENABLE_CAMERA

    choice WT_BSP_S31_CAMERA_SENSOR
        prompt "Camera sensor"
        default WT_BSP_S31_CAMERA_SENSOR_GC2145
        help
            Select the fitted camera module and capture mode. This also selects
            the matching sensor format and XCLK.

        config WT_BSP_S31_CAMERA_SENSOR_GC2145
            bool "GC2145 / CKS-K210-GC3.1 (UXGA, 8 fps)"
            select WT_BSP_CAMERA_SENSOR_GC2145
            help
                Use GC2145 DVP UYVY 1600x1200 at a nominal 8 fps with
                a 20 MHz XCLK and an output-clock divider of two, derived
                from the driver's full-resolution mode. Frames are encoded
                by the ESP32-S31 hardware JPEG encoder.

        config WT_BSP_S31_CAMERA_SENSOR_GC2145_720P
            bool "GC2145 / CKS-K210-GC3.1 (720p, 30 fps)"
            select WT_BSP_CAMERA_SENSOR_GC2145_720P
            help
                Use the sensor's centered 1280x720 window with a 24 MHz XCLK.
                Native DVP capture supplies UYVY directly to the hardware JPEG
                encoder on the ESP32-S31.

        config WT_BSP_S31_CAMERA_SENSOR_OV3660
            bool "OV3660 (legacy supported module)"
            select WT_BSP_CAMERA_SENSOR_OV3660
            help
                Keep the verified OV3660 sensor-native JPEG path at 640x480
                and 25 fps with a 20 MHz XCLK.
    endchoice

    config WT_BSP_S31_OV3660_AE_LEVEL
        int "OV3660 automatic-exposure target level"
        default -4
        range -5 5
        depends on WT_BSP_S31_CAMERA_SENSOR_OV3660
        help
            Set the OV3660 sensor's automatic-exposure target after selecting
            the video format. Lower values preserve highlights and produce a
            darker image; higher values brighten shadows. The -4 default is
            tuned for the verified bright, backlit office scene.

    config WT_BSP_S31_OV3660_JPEG_QUALITY
        int "OV3660 native JPEG quality"
        default 34
        range 1 40
        depends on WT_BSP_S31_CAMERA_SENSOR_OV3660
        help
            Set the quality of JPEG frames encoded inside the OV3660 sensor.
            Higher values improve detail and increase frame size. The sensor's
            VGA format table is approximately quality 31; 34 is the board default.

    config WT_BSP_S31_OV3660_SATURATION
        int "OV3660 saturation level"
        default 0
        range -2 2
        depends on WT_BSP_S31_CAMERA_SENSOR_OV3660
        help
            Override the VGA format table's low-saturation (-2) color matrix
            after selecting the format. Zero restores the neutral OV3660 matrix.

    config WT_BSP_S31_OV3660_SHARPNESS
        int "OV3660 sharpness level"
        default 2
        range -3 3
        depends on WT_BSP_S31_CAMERA_SENSOR_OV3660
        help
            Set the OV3660 manual sharpness level after selecting the format.
            The +2 default adds moderate edge definition without using the
            strongest and most artifact-prone +3 setting.

    config WT_BSP_S31_OV3660_DENOISE
        int "OV3660 denoise level"
        default 4
        range 0 8
        depends on WT_BSP_S31_CAMERA_SENSOR_OV3660
        help
            Set the OV3660 spatial denoise level. Zero disables denoise. The
            common sensor table uses the maximum offset associated with level 8;
            level 4 preserves more fine detail while retaining useful denoise.

    config WT_BSP_S31_JPEG_QUALITY
        int "Hardware JPEG fallback quality"
        default 60 if WT_BSP_S31_CAMERA_SENSOR_GC2145_720P
        default 80
        range 1 100
        help
            Quality for the ESP32-S31 hardware JPEG path used by GC2145 and by
            future compatible non-JPEG sensors. This does not affect the
            OV3660 sensor-native JPEG path.

    config WT_BSP_S31_JPEG_ENCODE_TIMEOUT_MS
        int "Hardware JPEG encoding timeout (ms)"
        depends on WT_BSP_S31_CAMERA_SENSOR_GC2145 || WT_BSP_S31_CAMERA_SENSOR_GC2145_720P
        default 200
        range 40 1000
        help
            Internal JPEG engine deadline, separate from the frame dequeue
            timeout. The UXGA backend uses it to override esp_video 2.3's
            fixed 40 ms deadline. This does not affect OV3660 native JPEG.

    config WT_BSP_S31_DQBUF_TIMEOUT_MS
        int "Camera/JPEG dequeue timeout (ms)"
        default 500 if WT_BSP_S31_CAMERA_SENSOR_GC2145_720P
        default 2000
        range 100 10000

endif
```

## components/wt_bsp/boards/WT9932S31-TINY/Kconfig.projbuild
```kconfig
config WT_BSP_SELECTED_BOARD_WT9932S31_TINY  # ignore: multiple-definition
    bool

choice WT_BSP_BOARD  # ignore: multiple-definition
    default WT_BSP_BOARD_WT9932S31_TINY if WT_BSP_SELECTED_BOARD_WT9932S31_TINY
    default WT_BSP_BOARD_WT9932S31_TINY if !WT_BSP_BOARD_SELECTED_BY_TOOL && IDF_TARGET_ESP32S31

    config WT_BSP_BOARD_WT9932S31_TINY
        bool "WT9932S31-TINY"
        depends on IDF_TARGET_ESP32S31
        select WT_BSP_BOARD_HAS_BOARD
        select WT_BSP_BOARD_HAS_BUTTON
        select WT_BSP_BOARD_HAS_RGB
        select WT_BSP_BOARD_HAS_SDMMC
        select WT_BSP_BOARD_HAS_USB_DEVICE_CDC
        select WT_BSP_BOARD_HAS_USB_DEVICE_UVC
        select WT_BSP_BOARD_HAS_CAMERA
endchoice
```

## components/wt_bsp/features/Kconfig.projbuild
```kconfig
menu "Feature selection"

    rsource "board/Kconfig.projbuild"
    rsource "button/Kconfig.projbuild"
    rsource "camera/Kconfig.projbuild"
    rsource "csi/Kconfig.projbuild"
    rsource "dsi/Kconfig.projbuild"
    rsource "rgb/Kconfig.projbuild"
    rsource "sdmmc/Kconfig.projbuild"
    rsource "touch/Kconfig.projbuild"
    rsource "usb_device_cdc/Kconfig.projbuild"

endmenu
```

## components/wt_bsp/features/camera/Kconfig.projbuild
```kconfig
config WT_BSP_BOARD_HAS_CAMERA
    bool

config WT_BSP_ENABLE_CAMERA
    bool "Enable JPEG camera capture"
    depends on WT_BSP_BOARD_HAS_CAMERA
    depends on SOC_LCDCAM_CAM_SUPPORTED && SOC_JPEG_ENCODE_SUPPORTED
    default y
    select ESP_VIDEO_ENABLE_DVP_VIDEO_DEVICE
    select ESP_VIDEO_ENABLE_HW_JPEG_ENC_VIDEO_DEVICE
    help
        Expose board-owned JPEG frames to an application. Camera hardware
        is prepared explicitly by the application. Recording, USB streaming
        and other consumers coordinate frame use in the application layer.

orsource "sensors/*/Kconfig.projbuild"

# Keep a value in sdkconfig.json even when the capability hides the bool.
config WT_BSP_DEP_CAMERA
    string
    default "y" if WT_BSP_ENABLE_CAMERA
    default "n"
```

## components/wt_bsp/features/camera/sensors/gc2145/Kconfig.projbuild
```kconfig
config WT_BSP_CAMERA_SENSOR_GC2145
    bool
    depends on WT_BSP_ENABLE_CAMERA
    select CAMERA_GC2145
    select CAMERA_GC2145_DVP_RGB565_BE_1600X1200_13FPS
    set CAMERA_GC2145_DVP_IF_FORMAT_INDEX_DEFAULT=1
    help
        Build the GC2145 driver and its UXGA base format for the reusable
        UYVY sensor profile. The board selects wiring and operating parameters.

if WT_BSP_CAMERA_SENSOR_GC2145

choice CAMERA_GC2145_DVP_DEFAULT_FMT  # ignore: multiple-definition
    default CAMERA_GC2145_DVP_DEFAULT_FMT_RGB565_BE_1600X1200_13FPS
endchoice

endif

config WT_BSP_CAMERA_SENSOR_GC2145_VGA
    bool
    depends on IDF_TARGET_ESP32S31 && WT_BSP_ENABLE_CAMERA
    help
        Build the native ESP32-S31 capture path for the GC2145 VGA profile.

config WT_BSP_CAMERA_SENSOR_GC2145_720P
    bool
    depends on IDF_TARGET_ESP32S31 && WT_BSP_ENABLE_CAMERA
    help
        Build the native ESP32-S31 capture path for the GC2145 720p profile.
```

## components/wt_bsp/features/camera/sensors/ov3660/Kconfig.projbuild
```kconfig
config WT_BSP_CAMERA_SENSOR_OV3660
    bool
    depends on WT_BSP_ENABLE_CAMERA
    select CAMERA_OV3660
    select CAMERA_OV3660_DVP_JPEG_640X480_25FPS
    set CAMERA_OV3660_DVP_IF_FORMAT_INDEX_DEFAULT=7
    help
        Build the OV3660 driver and its VGA native JPEG format. The board
        selects wiring, operating parameters and optional image tuning.

if WT_BSP_CAMERA_SENSOR_OV3660

choice CAMERA_OV3660_DVP_DEFAULT_FMT  # ignore: multiple-definition
    default CAMERA_OV3660_DVP_DEFAULT_FMT_JPEG_640X480_25FPS
endchoice

endif
```

## components/wt_bsp/features/dsi/Kconfig.projbuild
```kconfig
config WT_BSP_BOARD_HAS_DSI
    bool

config WT_BSP_ENABLE_DSI
    bool "Enable DSI display BSP"
    depends on WT_BSP_BOARD_HAS_DSI
    default y

config WT_BSP_BOARD_HAS_DSI_LCD_ADAPTERS
    bool

choice WT_BSP_DSI_LCD_ADAPTER
    prompt "DSI LCD adapter"
    depends on WT_BSP_ENABLE_DSI && WT_BSP_BOARD_HAS_DSI_LCD_ADAPTERS
    default WT_BSP_DSI_LCD_ADAPTER_DEFAULT

    config WT_BSP_DSI_LCD_ADAPTER_DEFAULT
        bool "Default ST7102 / ST7123 display"

    config WT_BSP_DSI_LCD_ADAPTER_WLK7002_MIPI_15P
        bool "WLK7002-MIPI-15P / JD9165BA / GT911"
        help
            Use the validated 1024x600 RGB565 JD9165BA panel configuration,
            two 500 Mbps lanes, 40 MHz DPI clock and 2 kHz backlight PWM.

    config WT_BSP_DSI_LCD_ADAPTER_WTDKP4_LCD_ADAPTER
        bool "WTDKP4-LCD-ADAPTER / EK79007 / GT911"
        help
            Use the validated 1024x600 RGB565 EK79007 panel configuration,
            two 1000 Mbps lanes, a 52 MHz DPI request and 5 kHz backlight PWM.
            ESP-IDF may round the requested pixel clock to its integer divider.
endchoice

# Keep a value in sdkconfig.json even when the capability hides the bool.
config WT_BSP_DEP_DSI
    string
    default "y" if WT_BSP_ENABLE_DSI
    default "n"
```

## components/wt_bsp/features/touch/Kconfig.projbuild
```kconfig
config WT_BSP_BOARD_HAS_TOUCH
    bool

config WT_BSP_ENABLE_TOUCH
    bool "Enable touch BSP"
    depends on WT_BSP_BOARD_HAS_TOUCH
    default y

# Keep a value in sdkconfig.json even when the capability hides the bool.
config WT_BSP_DEP_TOUCH
    string
    default "y" if WT_BSP_ENABLE_TOUCH
    default "n"

config WT_BSP_DEP_TOUCH_GT911
    string
    default "y" if WT_BSP_ENABLE_TOUCH && (WT_BSP_DSI_LCD_ADAPTER_WLK7002_MIPI_15P || WT_BSP_DSI_LCD_ADAPTER_WTDKP4_LCD_ADAPTER)
    default "n"
```

## components/wt_bsp/features/usb_device_cdc/Kconfig.projbuild
```kconfig
config WT_BSP_BOARD_HAS_USB_DEVICE_CDC
    bool

config WT_BSP_ENABLE_USB_DEVICE_CDC
    bool "Enable USB Device CDC BSP"
    depends on WT_BSP_BOARD_HAS_USB_DEVICE_CDC
    depends on !WT_BSP_ENABLE_USB_DEVICE_UVC || WT_BSP_USB_DEVICE_COMPOSITE
    select TINYUSB_CDC_ENABLED if !WT_BSP_USB_DEVICE_COMPOSITE
    default y
    help
        Provide a CDC ACM serial interface on the board USB OTG connector.
        The BSP owns the TinyUSB driver. This is separate from USB Serial
        JTAG. Boards with composite USB support can share the UVC stack;
        otherwise this feature owns a separate TinyUSB driver.
```
